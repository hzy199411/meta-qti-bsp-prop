## conf/machine/sdm845.conf
```bitbake
#@TYPE: Machine
#@NAME: SDA845
#@DESCRIPTION: Machine configuration for SDA845

require ${COREBASE}/meta-qti-bsp/conf/machine/sdm845.conf

# Pull in the security flags overrides for prop packages
require ${COREBASE}/meta-qti-bsp-prop/conf/distro/include/security_flags.inc

# Use sdllvm to compile some of the qti packages
LLVM_VERSION = "4.0"
INHERIT += "sdllvm"
require ${COREBASE}/meta-qti-bsp-prop/conf/machine/sdm845/sdllvmpkgs.conf

# Whitelist packages having commercial license.
LICENSE_FLAGS_WHITELIST  += "commercial_ffmpeg"
LICENSE_FLAGS_WHITELIST  += "commercial_lib32-gstreamer1.0-meta-base"
LICENSE_FLAGS_WHITELIST  += "commercial_lib32-gstreamer1.0"
LICENSE_FLAGS_WHITELIST  += "commercial_lib32-gstreamer1.0-plugins-base"
LICENSE_FLAGS_WHITELIST  += "commercial_lib32-gstreamer1.0-plugins-bad"
LICENSE_FLAGS_WHITELIST  += "commercial_lib32-gstreamer1.0-plugins-good"
LICENSE_FLAGS_WHITELIST  += "commercial_lib32-gstreamer1.0-plugins-ugly"
LICENSE_FLAGS_WHITELIST  += "commercial_lib32-gstreamer1.0-python"
LICENSE_FLAGS_WHITELIST  += "commercial_lib32-gstreamer1.0-rtsp-server"
LICENSE_FLAGS_WHITELIST  += "commercial_lib32-gstreamer1.0-omx"
LICENSE_FLAGS_WHITELIST  += "commercial_lib32-gstreamer1.0-libav"
LICENSE_FLAGS_WHITELIST  += "commercial_lib32-lame"
LICENSE_FLAGS_WHITELIST  += "commercial_lib32-mpg123"
LICENSE_FLAGS_WHITELIST  += "commercial_lib32-mpeg2dec"
```

## conf/machine/sdm845/sdllvmpkgs.conf
```bitbake
# List of pkgs to be built with sdllvm.

#TOOLCHAIN_pn-libui      = "sdllvm"
TOOLCHAIN_pn-camera     = "sdllvm"
TOOLCHAIN_pn-cameradbg  = "sdllvm"
TOOLCHAIN_pn-mm-3a-core = "sdllvm"
TOOLCHAIN_pn-mm-camera  = "sdllvm"
TOOLCHAIN_pn-mm-camerasdk     = "sdllvm"
TOOLCHAIN_pn-mm-camera-core   = "sdllvm"
TOOLCHAIN_pn-mm-camera-lib    = "sdllvm"
TOOLCHAIN_pn-mm-camera-noship = "sdllvm"
TOOLCHAIN_pn-mm-still         = "sdllvm"
TOOLCHAIN_pn-fastcv-noship    = "sdllvm"
TOOLCHAIN_pn-scve-noship      = "sdllvm"
TOOLCHAIN_pn-camx             = "sdllvm"
TOOLCHAIN_pn-chicdkgenerator  = "sdllvm"
TOOLCHAIN_pn-chicdk           = "sdllvm"
TOOLCHAIN_pn-camx-header      = "sdllvm"
#TOOLCHAIN_pn-qmmf-sdk         = "sdllvm"
#TOOLCHAIN_pn-media            = "sdllvm"
#TOOLCHAIN_pn-mm-video-noship  = "sdllvm"
#TOOLCHAIN_pn-mm-parser        = "sdllvm"
#TOOLCHAIN_pn-mm-parser-noship = "sdllvm"
#TOOLCHAIN_pn-mm-osal          = "sdllvm"
#TOOLCHAIN_pn-mm-video-utils   = "sdllvm"
#TOOLCHAIN_pn-vpp              = "sdllvm"
#TOOLCHAIN_pn-vpp-noship       = "sdllvm"
```
